## firmware/go_and_avoid/components/wheel/Kconfig
```kconfig
menu "Wheel Driver Configuration"

    config WHEEL_TIMER_RESOLUTION_HZ
        int "MCPWM Timer Resolution (Hz)"
        default 10000000
        help
            MCPWM timer resolution in Hz (default: 10 MHz = 0.1 us per tick).

    config WHEEL_PWM_FREQ_HZ
        int "PWM Frequency (Hz)"
        default 25000
        help
            Motor switching frequency (default: 25 kHz to avoid audible noise).

    config WHEEL_ENCODER_PCNT_HIGH_LIMIT
        int "PCNT High Limit Count"
        default 7000
        help
            Maximum pulse count before overflow on the ESP32 PCNT peripheral.
             Maximizing PCNT limits is critical for performance and driver validity:
              - Driver Requirement: Mandatory requirement by ESP-IDF driver (high_limit > 0 and low_limit < 0).
              - ISR Overhead Reduction: When accum_count is enabled, reaching these thresholds dispatches an internal driver ISR to update a 64-bit hardware accumulator. Maximizing limits minimizes ISR trigger frequency, reducing CPU overhead.
              - Overflow Prevention: Prevents hardware 16-bit counter saturation between polling cycles.

    config WHEEL_ENCODER_GLITCH_FILTER_NS
        int "Encoder Glitch Filter (nanoseconds)"
        default 1000
        help
            Maximum noise duration to be ignored on the encoder signal (in ns).

endmenu
```

## firmware/juca_firmware/components/diff_drive/Kconfig
```kconfig
menu "Differential Drive Configuration"

    config DIFF_DRIVE_HALF_TRACK_WIDTH
        int "Half track width (L/2) in meters 1000x"
        default 125
        help
            Lateral distance from the robot center to the wheel ground contact point.

    config DIFF_DRIVE_WHEEL_RADIUS
        int "Wheel radius (r) in meters 1000x"
        default 40
        help
            Effective rolling radius of the drive wheels.

    config DIFF_DRIVE_ENCODER_CPR
        int "Encoder counts per revolution (CPR) in 4x mode"
        default 1440
        range 0 100000
        help
            Total encoder resolution in 4x quadrature mode. Set to 0 if encoders are physically absent.

    config DIFF_DRIVE_MAX_LINEAR_VELOCITY
        int "Maximum linear velocity limit (m/s) 1000x"
        default 1000
        help
            Software safety clamp for linear velocity. Set to 0 to disable speed clamping.

    config DIFF_DRIVE_MAX_ANGULAR_VELOCITY
        int "Maximum angular velocity limit (rad/s) 1000x"
        default 3142
        help
            Software safety clamp for angular velocity. Set to 0 to disable speed clamping.

    config DIFF_DRIVE_MAX_WHEEL_RAD_S
        int "Theoretical maximum wheel angular velocity (rad/s) x1000"
        default 25000
        help
            Maximum rotational speed reached by the motors at 100% PWM duty cycle.

    menu "Safety and Overcurrent Protection"

        config DIFF_DRIVE_MAX_ADC_RAW_THRESHOLD
            int "ADC raw threshold limit for current cutoff"
            default 2800
            range 0 4095
            help
                Upper threshold limit for raw ADC readings. Set to 0 to disable the background monitoring task.

        config DIFF_DRIVE_MONITOR_PERIOD_MS
            int "Safety task monitor period (ms)"
            default 50
            help
                Sampling and evaluation interval for the current monitoring safety task in milliseconds.

        config DIFF_DRIVE_SAFETY_TASK_PRIORITY
            int "Safety task FreeRTOS priority"
            default 5
            range 1 24
            help
                FreeRTOS task priority for the safety task. MUST be strictly higher than the control task priority.

        config DIFF_DRIVE_SAFETY_STACK_SIZE
            int "Safety task stack size (bytes)"
            default 3072

    endmenu

    menu "Periodic Control Task and Acceleration Ramp"

        config DIFF_DRIVE_MAX_ACCEL_LINEAR
            int "Maximum linear acceleration (m/s^2) x1000"
            default 1000
            help
                Linear acceleration rate limit for smooth motion ramping. Set <= 0 to disable ramping (instant response).

        config DIFF_DRIVE_MAX_ACCEL_ANGULAR
            int "Maximum angular acceleration (rad/s^2) x1000"
            default 2000
            help
                Angular acceleration rate limit for smooth motion ramping. Set <= 0 to disable ramping.

        config DIFF_DRIVE_CONTROL_PERIOD_MS
            int "Control task execution period (ms)"
            default 20
            help
                Execution cycle period for the periodic control loop in milliseconds (20 ms = 50 Hz).

        config DIFF_DRIVE_CONTROL_TASK_PRIORITY
            int "Control task FreeRTOS priority"
            default 4
            range 1 24
            help
                FreeRTOS task priority for the control task. MUST be strictly lower than the safety task priority.

        config DIFF_DRIVE_CONTROL_STACK_SIZE
            int "Control task stack size (bytes)"
            default 3072

    endmenu

endmenu
```

## firmware/juca_firmware/components/mpu6050/Kconfig
```kconfig
menu "MPU6050 Driver"

    config MPU6050_I2C_PORT
        int "I2C port number"
        range 0 1
        default 0
        help
            I2C controller used to talk to the MPU6050.

    config MPU6050_SDA_GPIO
        int "SDA GPIO"
        range 0 SOC_GPIO_OUT_RANGE_MAX
        default 40
        help
            GPIO connected to the MPU6050 SDA line.

    config MPU6050_SCL_GPIO
        int "SCL GPIO"
        range 0 SOC_GPIO_OUT_RANGE_MAX
        default 39
        help
            GPIO connected to the MPU6050 SCL line.

    config MPU6050_I2C_FREQ_HZ
        int "I2C clock frequency (Hz)"
        range 10000 400000
        default 100000
        help
            I2C bus clock. The MPU6050 supports up to 400 kHz.

    config MPU6050_I2C_INTERNAL_PULLUPS
        bool "Enable internal pull-ups on SDA/SCL"
        default y
        help
            Disable this if your board already has external pull-up
            resistors (recommended for 400 kHz).

    config MPU6050_I2C_TIMEOUT_MS
        int "I2C transaction timeout (ms)"
        range 10 10000
        default 1000

    choice MPU6050_ADDR_SELECT
        prompt "I2C address (AD0 pin level)"
        default MPU6050_ADDR_AD0_LOW
        help
            Selects the 7-bit I2C address according to the AD0 pin.

        config MPU6050_ADDR_AD0_LOW
            bool "AD0 low (0x68)"

        config MPU6050_ADDR_AD0_HIGH
            bool "AD0 high (0x69)"
    endchoice

    config MPU6050_BUILD_INIT_LAYER
        bool "Build the board init layer (mpu6050init)"
        default y
        help
            Builds mpu6050_complete_init(), which runs the full bring-up
            (I2C, DMP load, calibration, DMP enable) using the pins above.
            Disable it if you want to drive the low-level API yourself.

    config MPU6050_CALIB_LOOPS
        int "Calibration iterations (gyro and accel)"
        depends on MPU6050_BUILD_INIT_LAYER
        range 1 255
        default 15
        help
            More iterations give better offsets but take longer.
            The sensor must stay still during calibration.

endmenu
```
